## conf/layer.conf
```bitbake
# We have a conf and classes directory, add to BBPATH
BBPATH .= ":${LAYERDIR}"

# We have recipes-* directories, add to BBFILES
BBFILES += "${LAYERDIR}/recipes-*/*/*.bb \
	${LAYERDIR}/recipes-*/*/*.bbappend"

BBFILE_COLLECTIONS += "elecex"
BBFILE_PATTERN_elecex = "^${LAYERDIR}/"
BBFILE_PRIORITY_elecex = "14"

LAYERDEPENDS_elecex = "nodejs"
```

## conf/machine/elecex-zgateway-mx6.conf
```bitbake
#@TYPE: Machine
#@NAME: Electricity Exchange ELECEX-ZGATEWAY-MX6
#@SOC: i.MX6Q/D/DL/S
#@DESCRIPTION: Machine configuration for Electricity Exchange ELECEX-ZGATEWAY-MX6
#@MAINTAINER: Adeel Arshad <embeddi.zone@gmail.com>
#@MAINTAINER: Yasir Khan <yasir_electronics@yahoo.com>

MACHINEOVERRIDES =. "mx6:mx6dl:mx6q:"
include conf/machine/include/imx-base.inc
include conf/machine/include/tune-cortexa9.inc



SERIAL_CONSOLE = "115200 ttymxc0"

MACHINE_FEATURES += " pci bluetooth touchscreen wifi"

# UBIFS for Variscite NAND 0.5 GB
MKUBIFS_ARGS = " -m 2048 -e 124KiB -c 3965 "
UBINIZE_ARGS = " -m 2048 -p 128KiB -s 2048 -O 2048 "

# UBIFS for Variscite NAND 1.0 GB (models with erase block size of 128KiB)
#MKUBIFS_ARGS = " -m 2048 -e 124KiB -c 7855 "
#UBINIZE_ARGS = " -m 2048 -p 128KiB -s 2048 -O 2048 "

# UBIFS for Variscite NAND 1.0 GB (models with erase block size of 512KiB)
#MKUBIFS_ARGS = " -m 4096 -e 504KiB -c 2000 "
#UBINIZE_ARGS = " -m 4096 -p 512KiB -s 4096 -O 4096 "

UBI_VOLNAME  = "rootfs"

# Variscite BSP default providers
PREFERRED_PROVIDER_virtual/kernel_elecex-zgateway-mx6 ?= "linux-variscite"
PREFERRED_VERSION_linux-variscite = "4.1.15"
KERNEL_DEVICETREE = " \
		     imx6q-elecex-zgateway.dtb \
		     "
KERNEL_IMAGETYPE = "uImage"

PREFERRED_PROVIDER_wpa-supplicant-cli = "wpa-supplicant"
PREFERRED_PROVIDER_wpa-supplicant-passphrase = "wpa-supplicant"
PREFERRED_PROVIDER_wpa-supplicant = "wpa-supplicant"

PREFERRED_PROVIDER_u-boot_elecex-zgateway-mx6 = "u-boot-variscite"
PREFERRED_PROVIDER_virtual/bootloader_elecex-zgateway-mx6 = "u-boot-variscite"
UBOOT_MAKE_TARGET = ""
SPL_BINARY          = "SPL"
UBOOT_SUFFIX        = "img"
UBOOT_CONFIG ??= "nand sd "
# The above order matters. The last one will be also called u-boot-${MACHINE} and will be used to create the sdcard.
UBOOT_CONFIG[sd] = "mx6var_som_sd_config,sdcard"
UBOOT_CONFIG[nand] = "mx6var_som_nand_config,ubifs"

MACHINE_EXTRA_RDEPENDS += " \
			   imx-kobs \
			   wlconf \
			   iw \
			   hostapd \
			   libnl \
			   crda \
			   wl18xx-target-scripts \
			   ti-compat-wireless-wl18xx \
			   ti-wifi-utils \
			   wpa-supplicant \
			   tslib-calibrate \
			   tslib-tests \
			   bluez5 \
			   ${@bb.utils.contains('DISTRO_FEATURES', 'pulseaudio', "variscite-bluetooth-snd-dev", "", d)} \
			   wl18xx-firmware \
			   u-boot-fw-utils \
			   u-boot-splash \
			   ${@bb.utils.contains('DISTRO_FEATURES', 'x11', "x11vnc", "", d)} \
			   bridge-utils \
			   "
# Packages added to all images (including core-image-minimal)
IMAGE_INSTALL_append = " \
        fsl-rc-local \
"

BBMASK_prepend = "fsl-image-mfgtool-initramfs "

IMAGE_FSTYPES = "tar.bz2 ext4 sdcard ubi"

PREFERRED_PROVIDER_start-stop-daemon = "dpkg-utils"

PACKAGE_CLASSES = "package_deb"

PREFERRED_VERSION_xserver-nodm-init = "1.0"
PREFERRED_VERSION_gnupg ?= "2.1.14"
```
